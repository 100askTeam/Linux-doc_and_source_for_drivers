
#define m 123

/{
   virtual_intc: virtual_intc_100ask {
        compatible = "100ask,virtual_intc";

        interrupt-controller;
        #interrupt-cells = <2>;

        interrupt-parent = <&intc>;
		upper_hwirq_base = <m>;
    };

    gpio_keys_100ask {
        compatible = "100ask,gpio_key";
        interrupt-parent = <&virtual_intc>;
        interrupts = <0 IRQ_TYPE_LEVEL_HIGH>,
                     <1 IRQ_TYPE_LEVEL_HIGH>,
                     <2 IRQ_TYPE_LEVEL_HIGH>,
                     <3 IRQ_TYPE_LEVEL_HIGH>;
    };
    
};
